## build/Kconfig/arch/Kconfig
```kconfig
# Load Zephyr Arch Kconfig descriptions.
osource "/home/hl/zephyrproject/zephyr/arch/rx/Kconfig"
osource "/home/hl/zephyrproject/zephyr/arch/x86/Kconfig"
osource "/home/hl/zephyrproject/zephyr/arch/xtensa/Kconfig"
osource "/home/hl/zephyrproject/zephyr/arch/sparc/Kconfig"
osource "/home/hl/zephyrproject/zephyr/arch/riscv/Kconfig"
osource "/home/hl/zephyrproject/zephyr/arch/posix/Kconfig"
osource "/home/hl/zephyrproject/zephyr/arch/mips/Kconfig"
osource "/home/hl/zephyrproject/zephyr/arch/arm64/Kconfig"
osource "/home/hl/zephyrproject/zephyr/arch/arm/Kconfig"
osource "/home/hl/zephyrproject/zephyr/arch/arc/Kconfig"
```

## build/Kconfig/boards/Kconfig.defconfig.tmp
```kconfig
# Load Zephyr board defconfig descriptions.
osource "/home/hl/zephyrproject/zephyr/boards/espressif/esp32s3_devkitc/Kconfig.defconfig"
```

## build/Kconfig/boards/Kconfig.esp32s3_devkitc
```kconfig
# Load board Kconfig descriptions.
osource "/home/hl/zephyrproject/zephyr/boards/espressif/esp32s3_devkitc/Kconfig.esp32s3_devkitc"
```

## build/Kconfig/boards/Kconfig.sysbuild
```kconfig
# Load Sysbuild board Kconfig descriptions.
osource "/home/hl/zephyrproject/zephyr/boards/espressif/esp32s3_devkitc/Kconfig.sysbuild"
```

## modules/drivers/aht10/drivers/aht10/Kconfig
```kconfig
config AHT10
    bool "Aosong AHT10/AHT20 temperature and humidity sensor"
    default n
    depends on I2C
    help
      Enable driver for Aosong AHT10/AHT20 sensors.
```

## modules/drivers/aht10/dts/bindings/sensor/aosong,aht10.yaml
```yaml
# Copyright (c) 2025 刘君
# SPDX-License-Identifier: Apache-2.0

description: Aosong AHT10/AHT20 temperature and humidity sensor

compatible: "aosong,aht10"

include: [sensor-device.yaml, i2c-device.yaml]

properties:

  # 可选：指定传感器 label（用于应用层识别）
  label:
    type: string
    description: Human-readable label for the sensor

  # 可选：电源域（如果硬件有使能引脚）
  # vdd-supply:
  #   type: phandle
  #   description: Regulator for VDD
```

## modules/drivers/dc01/drivers/dc01/Kconfig
```kconfig
config DC01
    bool "D01/DC01 Dust Sensor Driver"
    default n
    depends on DT_HAS_KUNLIU_DC01_ENABLED
    select UART_INTERRUPT_DRIVEN
    select RING_BUFFER
    help
      Enable driver for the D01 infrared dust sensor. [cite: 6]
```

## modules/drivers/dc01/dts/bindings/sensor/kunliu,dc01.yaml
```yaml
# Copyright (c) 2025 刘君
# SPDX-License-Identifier: Apache-2.0

description: KunLiu DC01 PM2.5 sensor

compatible: "kunliu,dc01"

include: sensor-device.yaml

properties:
  # 可选：指定传感器 label（用于应用层识别）
  label:
    type: string
    description: Sensor label
    default: "DC01_PM25_Sensor"
```
